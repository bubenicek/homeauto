#include <stdio.h>
#include <stdlib.h>
#include <stdint.h>
#include <errno.h>
#include <fcntl.h>
#include <string.h>
#include <assert.h>
#include <unistd.h>

#include "trace.h"
#include "serial.h"
#include "modbus.h"

#if !ENABLE_TRACE_MODBUS
#include "trace_undef.h"
#endif

#define CFG_DELAY_AFTER_TX    	      50
#define CFG_REQUST_RETRY_CNT	         3


/* Table of CRC values for high-order byte */
static const uint8_t table_crc_hi[] = {
    0x00, 0xC1, 0x81, 0x40, 0x01, 0xC0, 0x80, 0x41, 0x01, 0xC0,
    0x80, 0x41, 0x00, 0xC1, 0x81, 0x40, 0x01, 0xC0, 0x80, 0x41,
    0x00, 0xC1, 0x81, 0x40, 0x00, 0xC1, 0x81, 0x40, 0x01, 0xC0,
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    0x80, 0x41, 0x00, 0xC1, 0x81, 0x40
};

/* Table of CRC values for low-order byte */
static const uint8_t table_crc_lo[] = {
    0x00, 0xC0, 0xC1, 0x01, 0xC3, 0x03, 0x02, 0xC2, 0xC6, 0x06,
    0x07, 0xC7, 0x05, 0xC5, 0xC4, 0x04, 0xCC, 0x0C, 0x0D, 0xCD,
    0x0F, 0xCF, 0xCE, 0x0E, 0x0A, 0xCA, 0xCB, 0x0B, 0xC9, 0x09,
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    0x43, 0x83, 0x41, 0x81, 0x80, 0x40
};

static uint16_t crc16(uint8_t *buffer, uint16_t buffer_length)
{
    uint8_t crc_hi = 0xFF; /* high CRC byte initialized */
    uint8_t crc_lo = 0xFF; /* low CRC byte initialized */
    unsigned int i; /* will index into CRC lookup */

    /* pass through message buffer */
    while (buffer_length--) {
        i = crc_hi ^ *buffer++; /* calculate the CRC  */
        crc_hi = crc_lo ^ table_crc_hi[i];
        crc_lo = table_crc_lo[i];
    }

    return (crc_hi << 8 | crc_lo);
}

int modbus_rtu_read_response(int sd, int rspsize, uint8_t *buf, int bufsize)
{
   int length;
   uint16_t crc_calculated;
   uint16_t crc_received;

   length = rspsize + 2;  // included CRC

   if (serial_read(sd, buf, length) != length)
   {
      TRACE_ERROR("serial read failed");
      return -1;
   }

   crc_calculated = crc16(buf, rspsize);
   crc_received = (buf[length - 2] << 8) | buf[length - 1];
   
   if (crc_calculated != crc_received)
   {
      TRACE_ERROR("Bad response CRC");
      return -1;
   }
   
   return rspsize;
}

int modbus_rtu_write_request(int sd, int addr, uint8_t func, uint16_t regaddr, uint16_t regdata)
{
   int idx = 0;
   uint16_t crc;
   uint8_t buf[64];
   
   buf[idx++] = addr;
   buf[idx++] = func;
   buf[idx++] = (regaddr >> 8);
   buf[idx++] = regaddr & 0xFF;
   buf[idx++] = (regdata >> 8);
   buf[idx++] = regdata & 0xFF;
   
   crc = crc16(buf, idx);
   buf[idx++] = crc >> 8;
   buf[idx++] = crc & 0x00FF;
   
   return serial_write(sd, buf, idx);
}


int modbus_rtu_read_coils_state_fix(int sd, int addr, int start_coil, int count, uint16_t *state)
{
   int ix;
   uint8_t buf[64];
   
   *state = 0;
   for (ix = 0; ix < count; ix++)
   {      
      // Write request fix request for china relay board (not valid MODBUS !!)
      if (modbus_rtu_write_request(sd, addr, MODBUS_FUNC_READ_COILS, ix + start_coil, 0x4) < 0)
         return -1;

      usleep(CFG_DELAY_AFTER_TX * 1000);

      // Read response
      if (modbus_rtu_read_response(sd, 4, buf, sizeof(buf)) < 0)
         return -1;
         
      if (buf[MODBUS_RTU_DATA_IDX+1])
         *state |= (1 << ix);
   }

   return 0;
}

int modbus_rtu_read_coils_state(int sd, int addr, int start_coil, int count, uint16_t *state)
{
   int ix, retry, rsplen;
   uint8_t buf[64];
   
   *state = 0;

   for (retry = 0; retry < CFG_REQUST_RETRY_CNT; retry++)
   {
      // Write request 
      if (modbus_rtu_write_request(sd, addr, MODBUS_FUNC_READ_COILS, start_coil, count) < 0)
         return -1;

      usleep(CFG_DELAY_AFTER_TX * 1000);
         
      rsplen = 3; // addr + func + size
      rsplen += count / 8;

      // Read response
      if (modbus_rtu_read_response(sd, rsplen, buf, sizeof(buf)) > 0)
      {
         *state = buf[MODBUS_RTU_DATA_IDX+1];
         if (count / 8 == 2)
         {
            *state <<= 8;
            *state |= buf[MODBUS_RTU_DATA_IDX+2];
         }
         
         return 0;
      }
   }
        
   return -1;
}


int modbus_rtu_write_coil(int sd, int addr, int coil, int state)
{
   uint8_t buf[16];
   int retry;

   for (retry = 0; retry < CFG_REQUST_RETRY_CNT; retry++)
   {
      // Write request fix request 
      if (modbus_rtu_write_request(sd, addr, MODBUS_FUNC_WRITE_COIL, coil, state) < 0)
         return -1;

      usleep(CFG_DELAY_AFTER_TX * 1000);

      // Read response
      if (modbus_rtu_read_response(sd, 6, buf, sizeof(buf)) > 0)
         return 0;
   }

   return -1;
}

int modbus_rtu_read_inputs(int sd, int addr, int start_input, int count, uint16_t *state)
{
   int retry, rsplen;
   uint8_t buf[16];

   for (retry = 0; retry < CFG_REQUST_RETRY_CNT; retry++)
   {
      // Write request fix request 
      if (modbus_rtu_write_request(sd, addr, MODBUS_READ_DISCRETE_INPUTS, start_input, count) < 0)
         return -1;

      usleep(CFG_DELAY_AFTER_TX * 1000);
      
      // fix. bug china reley modules !!!
      if (count == 0)
         count = 8;

      rsplen = 3; // addr + func + size
      rsplen += count / 8;

      // Read response
      if (modbus_rtu_read_response(sd, rsplen, buf, sizeof(buf)) > 0)
      {
         *state = buf[MODBUS_RTU_DATA_IDX+1];
         if (count / 8 == 2)
         {
            *state <<= 8;
            *state |= buf[MODBUS_RTU_DATA_IDX+2];
         }
         
         return 0;
      }
   }

   return -1;
}

int modbus_rtu_write_sigle_register(int sd, int addr, int regaddr, int value)
{
   uint8_t buf[16];
   int retry;

   for (retry = 0; retry < CFG_REQUST_RETRY_CNT; retry++)
   {
      // Write request fix request 
      if (modbus_rtu_write_request(sd, addr, MODBUS_FUNC_WRITE_SINGLE_REGISTER, regaddr, value) < 0)
         return -1;

      usleep(CFG_DELAY_AFTER_TX * 1000);

      // Read response
      if (modbus_rtu_read_response(sd, 6, buf, sizeof(buf)) > 0)
         return 0;
   }

   return -1;
}
